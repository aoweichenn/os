OUTPUT_FORMAT(elf64-x86-64)
OUTPUT_ARCH(i386:x86-64)
ENTRY(OsKernelEntry)

OS_KERNEL_LINK_ADDRESS = @OS_KERNEL_LINK_ADDRESS@;
OS_KERNEL_PAGE_SIZE_BYTES = @OS_KERNEL_PAGE_SIZE_BYTES@;

PHDRS
{
    text PT_LOAD FLAGS(@OS_KERNEL_SEGMENT_FLAGS_READ_EXECUTE@);
    rodata PT_LOAD FLAGS(@OS_KERNEL_SEGMENT_FLAGS_READ_ONLY@);
    data PT_LOAD FLAGS(@OS_KERNEL_SEGMENT_FLAGS_READ_WRITE@);
}

SECTIONS
{
    . = OS_KERNEL_LINK_ADDRESS;
    os_kernel_image_start = .;

    .text ALIGN(OS_KERNEL_PAGE_SIZE_BYTES) :
    {
        os_kernel_text_start = .;
        KEEP(*(.text.os_kernel_entry))
        *(.text .text.*)
        os_kernel_text_end = .;
    } :text

    .rodata ALIGN(OS_KERNEL_PAGE_SIZE_BYTES) :
    {
        os_kernel_read_only_data_start = .;
        *(.rodata .rodata.*)
        os_kernel_read_only_data_end = .;
    } :rodata

    .data ALIGN(OS_KERNEL_PAGE_SIZE_BYTES) :
    {
        os_kernel_writable_data_start = .;
        *(.data .data.*)
        /*
         * freestanding 启动当前不执行初始化表，但部分显式 Initialize 的全局对象仍会
         * 生成条目。必须把它放在 NOLOAD BSS 之前；若让链接器作为 orphan section
         * 放到 BSS 后面，ELF 会为整段 BSS 生成文件填充，打包体积随静态池虚增。
         */
        KEEP(*(.init_array .init_array.*))
    } :data

    .bss ALIGN(OS_KERNEL_PAGE_SIZE_BYTES) (NOLOAD) :
    {
        *(.bss .bss.*)
        *(COMMON)
        os_kernel_writable_data_end = .;
    } :data

    os_kernel_image_end = .;

    /DISCARD/ :
    {
        *(.comment)
        *(.eh_frame)
        *(.note .note.*)
    }
}

ASSERT(DEFINED(OsKernelEntry), "缺少内核入口 OsKernelEntry")
