OUTPUT_FORMAT(elf64-x86-64)
OUTPUT_ARCH(i386:x86-64)
ENTRY(osUserEntry)

OS_USER_VIRTUAL_BASE = @OS_USER_VIRTUAL_BASE@;
OS_USER_PAGE_SIZE_BYTES = @OS_USER_PAGE_SIZE_BYTES@;

PHDRS
{
    text PT_LOAD FLAGS(@OS_USER_SEGMENT_FLAGS_READ_EXECUTE@);
    rodata PT_LOAD FLAGS(@OS_USER_SEGMENT_FLAGS_READ_ONLY@);
    data PT_LOAD FLAGS(@OS_USER_SEGMENT_FLAGS_READ_WRITE@);
}

SECTIONS
{
    . = OS_USER_VIRTUAL_BASE;

    .text ALIGN(OS_USER_PAGE_SIZE_BYTES) :
    {
        KEEP(*(.text.os_user_entry))
        *(.text .text.*)
    } :text

    .rodata ALIGN(OS_USER_PAGE_SIZE_BYTES) :
    {
        *(.rodata .rodata.*)
    } :rodata

    .data ALIGN(OS_USER_PAGE_SIZE_BYTES) :
    {
        *(.data .data.*)
    } :data

    .bss ALIGN(OS_USER_PAGE_SIZE_BYTES) (NOLOAD) :
    {
        *(.bss .bss.*)
        *(COMMON)
    } :data

    /DISCARD/ :
    {
        *(.comment)
        *(.eh_frame)
        *(.note .note.*)
    }
}

ASSERT(DEFINED(osUserEntry), "缺少用户入口 osUserEntry")
